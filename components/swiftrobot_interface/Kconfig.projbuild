## components/swiftrobot_interface/Kconfig.projbuild
```kconfig
menu "Tinycar Master Configuration"

    config MASTER_HOST_IP
        string "IPv4 Address"
        default "tinycar_esp"
        help
            Host address of the swiftrobot master

    config MASTER_PORT
        int "Port"
        range 1 9999
        default 4455
        help
            Open port of the swiftrobot master
endmenu
```

## components/wifi/Kconfig.projbuild
```kconfig
menu "Tinycar AP Configuration"

    config ESP_WIFI_SSID
        string "WiFi SSID"
        default "tinycar_esp"
        help
            SSID (network name) for the tinycar to create.

    config ESP_WIFI_PASSWORD
        string "WiFi Password"
        default "tinycar123"
        help
            WiFi password (WPA or WPA2) for the tinycar to use.
    config ESP_WIFI_CHANNEL
        int "WiFi Channel"
        range 1 13
        default 1
        help
            WiFi channel (network channel) for the tinycar to use.

    config ESP_MAX_STA_CONN
        int "Maximal STA connections"
        default 4
        help
            Max number of the STA connects to AP.
endmenu
```
